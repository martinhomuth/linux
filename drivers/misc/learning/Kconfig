## drivers/misc/learning/Kconfig
```kconfig
config LEARNING_MODULES
	tristate "Adds the learning modules to the kernel"
	default y
	help
	  This driver set includes all the modules that are based on
	  the kernel learning process.
```

## drivers/misc/scull/Kconfig
```kconfig
config SCULL
	tristate "Adds the scull driver"
	default y
	help
	  This driver represents a real device named
	  "Simple Character Utility for Loading Localities"
```
